## main/Kconfig.projbuild
```kconfig
menu "Настройка ESP32-Радиолы"
    menu "Конфигурация GPIOS"
        choice
            prompt "Хост SPI"
            bool
            default HARDWARE_HOST
            help
                Выбор хоста SPI

            config HARDWARE_HOST
                bool "Аппаратный хост"
            config VIRTUAL_HOST
                bool "Виртуальный хост"
        endchoice
 
        menu "Шина SPI"
            config MISO_GPIO
                int "Номер пина SPI MISO"
                range 0 33
                default 19
                help
                    Установите номер GPIO, используемый SPI MISO.
            config MOSI_GPIO
                int "Номер пина SPI MOSI"
                range 0 33
                default 23
                help
                    Установите номер GPIO, используемый SPI MOSI.
            config SCLK_GPIO
                int "Номер пина SPI SCLK"
                range 0 33
                default 18
                help
                    Установите номер GPIO, используемый SPI SCLK.
        endmenu

        menu "VS10xx"
            config XCS_GPIO
                int "Номер пина XCS"
                range 0 39
                default 5
                help
                    Установите номер GPIO, используемый XCS.
            config XDCS_GPIO
                int "Номер пина XDCS"
                range 0 39
                default 32
                help
                    Установите номер GPIO, используемый XDCS.
            config DREQ_GPIO
                int "Номер пина DREQ"
                range 0 39
                default 4
                help
                    Установите номер GPIO, используемый DREQ.
        endmenu

        menu "Дисплей"
            config LCD_CS_GPIO
                int "Номер пина LCD_CS"
                range 0 39
                default 27
                help
                    Установите номер GPIO, используемый LCD_CS.
            config LCD_DC_GPIO
                int "Номер пина LCD_DC"
                range 0 39
                default 2
                help
                    Установите номер GPIO, используемый LCD_DC.
            config LCD_BACKLIGHT_GPIO
                int "Номер пина LCD_BACKLIGHT"
                range 0 39
                default 26
                help
                    Установите номер GPIO, используемый LCD_BACKLIGHT.
        endmenu

        choice
            prompt "Тачскрин"
            default TOUCH_SENSOR_NONE
            help
                Тачскрин.

            config TOUCH_SENSOR_NONE
                bool "Отсутствует"
            config TOUCH_SENSOR_PRESENT
                bool "Присутствует"
        endchoice
        menu "Пин тачскрина"
            depends on TOUCH_SENSOR_PRESENT
            config TOUCH_GPIO
                int "Номер пина TOUCH_SIG"
                range 0 39
                default 0
                help
                    Установите номер GPIO, используемый TOUCH_SIG.
        endmenu

        choice
            prompt "Шина I2C"
            default BUS_I2C_PRESENT
            help
                Шина I2C.
            config BUS_I2C_NONE
                bool "Отсутствует"
            config BUS_I2C_PRESENT
                bool "Присутствует"
        endchoice
        menu "Пины управления шиной I2C"
            depends on BUS_I2C_PRESENT
            config I2C_SDA_GPIO
            int "Номер пина I2C_SDA"
            range 0 39
            default 21
            help
                Установите номер GPIO, используемый I2C_SDA.
            config I2C_SCL_GPIO
            int "Номер пина I2C_SCL"
            range 0 39
            default 22
            help
                Установите номер GPIO, используемый I2C_SCL.
        endmenu

        choice
            prompt "Пульт ДУ"
            default IR_SENSOR_PRESENT
            help
                Пульт ДУ.
            config IR_SENSOR_NONE
                bool "Отсутствует"
            config IR_SENSOR_PRESENT
                bool "Присутствует"
        endchoice
        menu "Пин пульта ДУ"
            depends on IR_SENSOR_PRESENT
            config IR_SIG_GPIO
                int "Номер пина IR_SIG"
                range 0 39
                default 35
                help
                    Установите номер GPIO, используемый IR_SIG.
        endmenu

        choice
            prompt "Тип управления Радиолой"
            default TYPE_INPUT_NONE
            help
                Тип управления Радиолой.
            config TYPE_INPUT_NONE
                bool "Отсутствует"
            config TYPE_INPUT_ENCODER
                bool "Управление энкодером"
                depends on TEMPERATURE_SENSOR_NONE
            config TYPE_INPUT_KEYBOARD
                bool "Управление клавиатурой"
        endchoice

        menu "Клавиатура"
            depends on TYPE_INPUT_KEYBOARD        
            config KBD_GPIO
                int "Номер пина KBD"
                range 0 39
                default 34
                help
                    Установите номер GPIO, используемый KBD.
        endmenu

        menu "Энкодер"
            depends on TYPE_INPUT_ENCODER
             config ENC_A_GPIO
                int "Номер пина ENC_A"
                range 0 39
                default 14
                help
                    Установите номер GPIO, используемый ENC_A.
            config ENC_B_GPIO
                int "Номер пина ENC_B"
                range 0 39
                default 13
                help
                    Установите номер GPIO, используемый ENC_B.
            config ENC_BTN_GPIO
                int "Номер пина ENC_BTN"
                range 0 39
                default 34
                help
                    Установите номер GPIO, используемый ENC_BTN.
        endmenu

        choice
            prompt "Датчик измерения температуры"
            default TEMPERATURE_SENSOR_PRESENT
            help
                Датчик измерения температуры.
            config TEMPERATURE_SENSOR_NONE
                bool "Отсутствует"
            config TEMPERATURE_SENSOR_PRESENT
                bool "Присутствует"
        endchoice
        menu "Пин датчика температуры"
            depends on TEMPERATURE_SENSOR_PRESENT
            config DS18B20_GPIO
            int "Номер пина DS18B20"
            range 0 39
            default 14
            help
                Установите номер GPIO, используемый DS18B20.
        endmenu

        choice
            prompt "Вентилятор охлаждения усилителя"
            default COOLER_PRESENT
            help
                Вентилятор охлаждения усилителя.
            config COOLER_NONE
                bool "Отсутствует"
            config COOLER_PRESENT
                bool "Присутствует"
        endchoice
        menu "Пины управления вентилятором"
            depends on COOLER_PRESENT
            config PWM_GPIO
            int "Номер пина PWM"
            range 0 39
            default 13
            help
                Установите номер GPIO, используемый PWM.
            config TACH_GPIO
            int "Номер пина TACH"
            range 0 39
            default 12
            help
                Установите номер GPIO, используемый TACH.
        endmenu

        choice
            prompt "Блютуз-модуль BTxxx"
            default BT201_PRESENT
            help
                Блютуз-модуль BTxxx.
            config BT201_NONE
                bool "Отсутствует"
            config BT201_PRESENT
                bool "Присутствует"
        endchoice
        menu "Пины управления блютуз-модулем"
            depends on BT201_PRESENT
            config RXD_GPIO
            int "Номер пина RXD"
            range 0 39
            default 36
            help
                Установите номер GPIO, используемый RXD.
            config TXD_GPIO
            int "Номер пина TXD"
            range 0 39
            default 15
            help
                Установите номер GPIO, используемый TXD.
        endmenu

       choice
            prompt "Звуковое оповещение"
            default BUZZER_PRESENT
            help
                Звуковое оповещение.
            config BUZZER_NONE
                bool "Отсутствует"
            config BUZZER_PRESENT
                bool "Присутствует"
        endchoice
        menu "Пин управления звуком"
            depends on BUZZER_PRESENT
            config BUZZ_GPIO
            int "Номер пина BUZZ"
            range 0 39
            default 33
            help
                Установите номер GPIO, используемый BUZZ.
        endmenu 

        choice
            prompt "Датчик освещения"
            default LDR_SENSOR_PRESENT
            help
                Датчик освещения.
            config LDR_SENSOR_NONE
                bool "Отсутствует"
            config LDR_SENSOR_PRESENT
                bool "Присутствует"
        endchoice
        menu "Пин датчика освещения"
            depends on LDR_SENSOR_PRESENT
            config LDR_GPIO
            int "Номер пина LDR"
            range 0 39
            default 39
            help
                Установите номер GPIO, используемый LDR.
        endmenu

        choice
            prompt "Управление усилителем"
            default AMPLIFIER_CONTROL_NONE
            help
                Управление усилителем.
            config AMPLIFIER_CONTROL_NONE
                bool "Отсутствует"
            config AMPLIFIER_CONTROL_PRESENT
                bool "Присутствует"
        endchoice
        menu "Пин управления усилителем"
            depends on AMPLIFIER_CONTROL_PRESENT
            config STB_GPIO
            int "Номер пина STB"
            range 0 39
            default 25
            help
                Установите номер GPIO, используемый STB.
        endmenu

        choice
            prompt "сигнал STAND BY"
            depends on AMPLIFIER_CONTROL_PRESENT
            default STAND_BY_HIGH
            help
                Управление усилителем.
            config STAND_BY_HIGH
                bool "Высокий"
            config STAND_BY_LOW
                bool "Низкий"
        endchoice

        choice
            prompt "Кнопка сброса настроек Радиолы."
            default BUTTON_RESET_NONE
            help
                Сброс настроек Радиолы кнопкой энкодера или клавиатуры
            config BUTTON_RESET_NONE
                bool "НЕТ"
            config BUTTON_RESET_PRESENT
                bool "ДА"
        endchoice
    endmenu

    menu "Конфигурация Wifi"
        choice
            prompt "Сеть Wi-Fi №1"
            default WIWI1_PRESENT
            help
                Сеть Wi-Fi №1.
            config WIWI1_PRESENT
                bool "Включена"
            config WIWI1_NONE
                bool "Выключена"
        endchoice
        menu "Настройка Wi-Fi №1"
            depends on WIWI1_PRESENT
            choice
                prompt "Автоматическое получение IP"
                default DHCP1_PRESENT
                help
                    Автоматическое получение IP.
                config DHCP1_PRESENT
                    bool "ДА"
                config DHCP1_NONE
                    bool "НЕТ"
            endchoice
            config WIFI_SSID1
                string "Название Wi-Fi сети №1"
                default "OpenWrt"
                help
                    SSID №1 (имя сети) для подключения.
            config WIFI_PASSWORD1
                string "Пароль WiFi сети №1"
                default "1234567890"
                help
                    Пароль Wi-Fi №1 (WPA или WPA2) для использования.
                    Может быть оставлено пустым, если для сети не настроена безопасность.
            config IPADDRESS1
                string "IP Радиолы сети №1"
                depends on DHCP1_NONE
                default "192.168.1.254"
            config GATEWAY1
                string "IP Шлюза роутера сети №1"
                depends on DHCP1_NONE
                default "192.168.1.1"
            config MASK1
                string "Маска сети сети №1"
                depends on DHCP1_NONE
                default "255.255.255.0"
        endmenu

        choice
            prompt "Сеть Wi-Fi №2"
            default WIWI2_NONE
            help
                Сеть Wi-Fi №2.
            config WIWI2_PRESENT
                bool "Включена"
            config WIWI2_NONE
                bool "Выключена"
        endchoice
        menu "Настройка Wi-Fi №2"
            depends on WIWI1_PRESENT
            choice
                prompt "Автоматическое получение IP"
                default DHCP2_PRESENT
                help
                    Автоматическое получение IP.
                config DHCP2_PRESENT
                    bool "ДА"
                config DHCP2_NONE
                    bool "НЕТ"
            endchoice
            config WIFI_SSID2
                string "Название Wi-Fi сети №2"
                default "OpenWrt1"
                help
                    SSID №2 (имя сети) для подключения.
            config WIFI_PASSWORD2
                string "Пароль WiFi сети №2"
                default "1234567890"
                help
                    Пароль Wi-Fi №2 (WPA или WPA2) для использования.
                    Может быть оставлено пустым, если для сети не настроена безопасность.
            config IPADDRESS2
                string "IP Радиолы сети №2"
                depends on DHCP2_NONE
                default "192.168.1.250"
            config GATEWAY2
                string "IP Шлюза роутера сети №2"
                depends on DHCP2_NONE
                default "192.168.1.1"
            config MASK2
                string "Маска сети сети №2"
                depends on DHCP2_NONE
                default "255.255.255.0"
        endmenu
    endmenu

    menu "Серверы точного времени"
        config NTP0
            string "NTP №0"
            default "0.pool.ntp.org"

        config NTP1
            string "NTP №1"
            default "1.pool.ntp.org"

        config NTP2
            string "NTP №2"
            default "2.pool.ntp.org"

        config NTP3
            string "NTP №3"
            default "3.pool.ntp.org"

        choice
            prompt "Метод синхронизации времени"
            default SNTP_TIME_SYNC_METHOD_IMMED
            help
                Метод синхронизации времени.

            config SNTP_TIME_SYNC_METHOD_IMMED
                bool "время обновляется сразу после получения"
            config SNTP_TIME_SYNC_METHOD_SMOOTH
                bool "время обновляется плавно, методом (adjtime)"
        endchoice
    endmenu 

    menu "Настройка часового пояса"
        choice
            prompt "Выберите свой часовой пояс"
            default TZONE_5
            help
                Выбор часового пояса

            config TZONE_1
                bool "Киев, София"
            config TZONE_2
                bool "Калинингад"
            config TZONE_3
                bool "Москва"
            config TZONE_4
                bool "Самара"
            config TZONE_5
                bool "Екатеринбург"
            config TZONE_6
                bool "Омск"
            config TZONE_7
                bool "Красноярск"
            config TZONE_8
                bool "Иркутск"
            config TZONE_9
                bool "Чита"
            config TZONE_10
                bool "Владивосток"
            config TZONE_11
                bool "Южно-Сахалинск"
            config TZONE_12
                bool "Петропавловск-Камчатский"
        endchoice
        config TZONE
            string
            default "EET-2EEST,M3.5.0/3,M10.5.0/4" if TZONE_1
            default "EET-2" if TZONE_2
            default "MSK-3" if TZONE_3
            default "SAMT-4" if TZONE_4
            default "YEKT-5" if TZONE_5
            default "OMST-6" if TZONE_6
            default "KRAT-7" if TZONE_7
            default "IRKT-8" if TZONE_8
            default "YAKT-9" if TZONE_9
            default "VLAT-10" if TZONE_10
            default "SAKT-11" if TZONE_11
            default "PETT-12" if TZONE_12
    endmenu

    menu "Формат вывода даты"
        choice
            prompt "Выберите формат вывода даты"
            default DATAFORMAT_0
            help
                Выбор часового пояса

            config DATAFORMAT_0
                bool "4 ноября, СР. 2020 г."
            config DATAFORMAT_1
                bool "4 ноября, среда"
        endchoice
        config DATAFORMAT
            hex
            default 0xFE if DATAFORMAT_0
            default 0x01 if DATAFORMAT_1
    endmenu
endmenu
```
